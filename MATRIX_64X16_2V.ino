#include <avr/pgmspace.h>
#include <SPI.h>
#include "HUB08SPI.h"
#include <TimerOne.h>

#define WIDTH   64
#define HEIGHT  32

HUB08SPI display;
uint8_t displaybufTakiss1[WIDTH * HEIGHT / 8] {
  0x80, 0x00, 0x00, 0x00, 0x00, 0x00, 0x00, 0x01,
  0x00, 0x00, 0x00, 0x00, 0x00, 0x00, 0x00, 0x00,
  0x00, 0x00, 0x00, 0x00, 0x00, 0x00, 0x00, 0x00,
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  0x80, 0x00, 0x00, 0x00, 0x00, 0x00, 0x00, 0x01,
};
uint8_t displaybufTakiss2[WIDTH * HEIGHT / 8] {
  0xF0, 0x00, 0x00, 0x00, 0x00, 0x00, 0x00, 0x3F,
  0x18, 0x00, 0x00, 0x00, 0x00, 0x00, 0x00, 0xE0,
  0x08, 0x00, 0x00, 0x00, 0x00, 0x00, 0x01, 0x80,
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  0xF0, 0x00, 0x00, 0x00, 0x00, 0x00, 0x00, 0x03,
};
uint8_t displaybufTakiss3[WIDTH * HEIGHT / 8] {
  0x00, 0x00, 0x00, 0x00, 0x00, 0x00, 0x00, 0x00,
  0x00, 0x00, 0x00, 0x00, 0x00, 0x00, 0x00, 0x00,
  0x00, 0x00, 0x00, 0x00, 0x00, 0x00, 0x00, 0x00,
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  0x00, 0x00, 0x00, 0x00, 0x00, 0x00, 0x00, 0x00,
};
uint8_t displaybufTakiss4[WIDTH * HEIGHT / 8] {
  0x00, 0x00, 0x00, 0x00, 0x00, 0x00, 0x00, 0x00,
  0x00, 0x00, 0x00, 0x00, 0x00, 0x00, 0x00, 0x00,
  0x00, 0x00, 0x00, 0x00, 0x00, 0x00, 0x00, 0x00,
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  0x00, 0x00, 0x00, 0x00, 0x00, 0x00, 0x00, 0x00,
};

uint8_t displaybufStart[WIDTH * HEIGHT / 8] {
  0x80, 0x00, 0x00, 0x00, 0x00, 0x00, 0x00, 0x01,
  0x00, 0x00, 0x00, 0x00, 0x00, 0x00, 0x00, 0x00,
  0x38, 0x00, 0x00, 0x00, 0x00, 0x00, 0x00, 0x1C,
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  0x80, 0x00, 0x00, 0x00, 0x00, 0x00, 0x00, 0x01,
};
uint8_t displaybuf[WIDTH * HEIGHT / 8];

//16*16 pixel Γράμμα, το πρώτο byte είναι το πλάτος του χαρακτήρα

const PROGMEM  uint8_t font[] = {
  0x09, 0x00, 0x00, 0x00, 0x00, 0x00, 0x00, 0x00, 0x00, 0x00, 0x00, 0x00,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 0x00,   // char 32
  0x03, 0xe0, 0x00, 0xe0, 0x00, 0xe0, 0x00, 0xe0, 0x00, 0xe0, 0x00, 0xe0,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 0x00,   // char 33: !
  0x08, 0xe7, 0x00, 0xe7, 0x00, 0xe7, 0x00, 0xe7, 0x00, 0xe7, 0x00, 0x00, 0x00, 0x00, 0x00, 0x00, 0x00, 0x00, 0x00, 0x00, 0x00, 0x00, 0x00, 0x00, 0x00, 0x00, 0x00, 0x00, 0x00, 0x00, 0x00, 0x00, 0x00,   // char 34: "
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  0x0C, 0x00, 0x00, 0x01, 0x80, 0x01, 0x00, 0x02, 0x00, 0x00, 0x00, 0x60,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 0xC0,   // char 254: ώ
};


//€ ©

char * string [] = {"ΤΑ ΠΑΝΤΑ ΓΙΑ ΤΟ ΚΑΤΙΚΙΔΙΟ ΣΑΣ",
                    "ΠΡΟΣΦΟΡΕΣ",
                    "Ανοιχτά καθημερινά από 9:00 εώς 21:00 και Σάββατα από 9:00 εώς 15:00",
                    "Παμε να δούμε τηλεόραση το έργο << Ο ύπνος της Μαρίας >> χα χα",
                    "Σκυλοτροφές από 0,50€",
                    "Κλουβιά από 10€",

                   };

uint16_t length = 0;

void setup() {

  //Serial.begin(115200);

  display.begin(displaybufStart, WIDTH, HEIGHT);
  display.setBrightness(68);
  Timer1.initialize(200);  //slightly faster refresh rate
  Timer1.attachInterrupt(refresh);
  delay(2000);
  display.clear();

  length = 4000;
};

volatile uint16_t x = 0;

void loop() {

}
void refresh() {
  static uint16_t count = 0;
  count++;
  if (count > 180) { //scoll every 180 line scans
    count = 0;
    x++;
    if (x > length) x = 0;  //reset after 480 pixels
  }
  display.scan();  //refresh a single line of the display
}
void printString(char* string, int x) {
  while (*string) {
    byte c = *string - 32;
    printChar(c, x, 0);
    x += pgm_read_byte_near(font + (c * 33)) + 1;
    string++;
  }
}
void printChar(byte c, int x, int y) {
  byte l = pgm_read_byte_near(font + (c * 33)) + 1; //get pixel width of character
  for (int a = 0; a < 16; a++) {
    clearLine(x, y + a, l);
    writeByte(x, y + a, pgm_read_byte_near(font + (c * 33) + a * 2 + 1));
    writeByte(x + 8, y + a, pgm_read_byte_near(font + (c * 33) + a * 2 + 2));
  }
}
void writeByte(int x, int y, uint8_t data)
{
  if (x >= WIDTH || y >= HEIGHT || x + 8 <= 0 || y < 0) return; //outside screen
  uint8_t offset = x & 7;  //bit offset
  if (offset) //not aligned
  {
    writeByte(x - offset, y, data >> offset);
    writeByte(x + 8 - offset, y, data << (8 - offset));
  }
  else     //Aligned byte
  {
    uint8_t col = x / 8;
    displaybuf[y * 8 + col] |= data;
  }
}
void clearLine(int x, int y, int w)
{
  if (y < 0 || y >= HEIGHT || x >= WIDTH) return;
  if (x < 0)
  {
    w = w + x;
    x = 0;
  }
  if (x + w > WIDTH)
    w = WIDTH - x;
  if (w <= 0) return;
  if ((x & 7) + w <= 8)
  {
    uint8_t m = 0xFF << (8 - w);
    m >>= (x & 7);
    displaybuf[y * 8 + x / 8] &= ~m;
  }
  else
  {
    uint16_t start = y * 8 + (x + 7) / 8; //included
    uint16_t end =   y * 8 + (x + w) / 8; //not included
    if (x & 7) displaybuf[start - 1] &= ~(0xFF >> (x & 7));
    for (uint16_t p = start; p < end ; p++) displaybuf[p] = 0;
    if ((x + w) & 7) displaybuf[end] &= ~(0xFF << (8 - (x + w) & 7));
  }
}
